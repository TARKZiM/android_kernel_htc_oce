//===============================================================
//  ARM: dts: msm: Mount the system partition during early init
//
//  Add support to early mount system partition so that system
//  modules can be loaded during early init for UFS.
//===============================================================

/ {
    firmware: firmware {
        android {
            compatible = "android,firmware";
            fstab {
                compatible = "android,fstab";
                
            };
        };
    };
};
